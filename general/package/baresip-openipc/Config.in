## general/package/baresip-openipc/Config.in
```kconfig
config BR2_PACKAGE_BARESIP_OPENIPC
    bool "baresip-openipc"
    select BR2_PACKAGE_LIBRE_OPENIPC
    select BR2_PACKAGE_MBEDTLS
    select BR2_PACKAGE_FFMPEG_OPENIPC
    select BR2_PACKAGE_ALSA_LIB
    select BR2_PACKAGE_LIBV4L
	help
	  Baresip is a portable and modular SIP User-Agent with audio
	  and video support. Copyright (c) 2010 - 2024 Alfred E. Heggestad
	  and Contributors Distributed under BSD license.

	  https://github.com/baresip/baresip
```

## general/package/sigmastar-audiodaemon/Config.in
```kconfig
config BR2_PACKAGE_SIGMASTAR_AUDIODAEMON
    bool "sigmastar-audiodaemon"
    help
      Native SigmaStar MI audio daemon for zero-latency 2-way intercom.
      https://github.com/jyav/sigmastar-audiodaemon
```
